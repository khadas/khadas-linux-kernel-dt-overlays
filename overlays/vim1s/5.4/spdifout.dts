/dts-v1/;
/plugin/;

/ {
    fragment@0 {
        target = <&spdifa>;

        __overlay__ {
			pinctrl-names = "spdif_pins", "spdif_pins_mute";
			pinctrl-0 = <&spdifout>;
			pinctrl-1 = <&spdifout_a_mute>;

			status = "okay";
        };
    };
};                                                               
