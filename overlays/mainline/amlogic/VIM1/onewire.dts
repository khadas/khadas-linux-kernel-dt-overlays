/dts-v1/;
/plugin/;

#include <dt-bindings/gpio/meson-gxl-gpio.h>
#include <dt-bindings/gpio/gpio.h>

/ {
	fragment@0 {
		target-path = "/";

		__overlay__ {
			onewire {
				compatible = "w1-gpio";
				gpios = <&gpio GPIOH_5 GPIO_ACTIVE_HIGH>;
				#gpio-cells = <1>;
				status = "okay";
			};
		};
	};
};
