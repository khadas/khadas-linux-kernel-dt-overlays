/dts-v1/;
/plugin/;

#include <dt-bindings/gpio/meson-gxl-gpio.h>
#include <dt-bindings/gpio/gpio.h>

/ {
	// onewire using GPIOH_6, so we have to disable pwm_f & uart_C
	// which share the same pins
	fragment@0 {
		target-path = "/";

		__overlay__ {
			onewire {
				compatible = "w1-gpio";
				gpios = <&gpio GPIOH_6 GPIO_ACTIVE_HIGH>;
				#gpio-cells = <1>;
				status = "okay";
			};
		};

	};

	fragment@1 {
		target = <&spicc1>;

		__overlay__ {
			status = "disabled";
		};
	};

	fragment@2 {
		target = <&uart_C>;

		__overlay__ {
			status = "disabled";
		};
	};
};
