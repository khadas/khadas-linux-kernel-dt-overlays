/dts-v1/;
/plugin/;

/ {
	fragment@0 {
		target = <&spi1>;

		__overlay__ {
			status = "okay";

			#address-cells = <1>;
			#size-cells = <0>;

			spidev@0 {
				status = "okay";
				compatible = "linux,spidev";
				/* spi default max clock 100Mhz */
				spi-max-frequency = <100000000>;
				reg = <0>;
			};
		};
	};
};
