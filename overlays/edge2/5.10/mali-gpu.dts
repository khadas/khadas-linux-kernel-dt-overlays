/dts-v1/;
/plugin/;

/ {
	fragment@0 {
		target = <&gpu>;

		__overlay__ {
			mali-supply = <&vdd_gpu_s0>;
			mem-supply = <&vdd_gpu_mem_s0>;
			status = "okay";
		};
	};
	fragment@1 {
		target = <&gpu_panthor>;

		__overlay__ {
			status = "disabled";
		};
	};
};
